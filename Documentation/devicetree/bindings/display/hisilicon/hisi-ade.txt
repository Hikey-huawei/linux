## Documentation/devicetree/bindings/display/hisilicon/hisi-ade.txt
```
Device-Tree bindings for hisilicon ADE display controller driver

ADE (Advanced Display Engine) is the display controller which grab image
data from memory, do composition, do post image processing, generate RGB
timing stream and transfer to DSI.

Required properties:
- compatible: value should be "hisilicon,hi6220-ade".
- reg: physical base address and length of the controller's registers.
  Three reg ranges are used in ADE driver:
  ADE reg range, value should be "<0x0 0xf4100000 0x0 0x7800>";
  media subsystem reg range, value should be "<0x0 0xf4410000 0x0 0x1000>";
  media subsystem NOC QoS reg range, value should be "<0x0 0xf4520000 0x0
  0x1000>".
- reg-names: name of physical base.Valuse should be "ade_base",	"media_base"
  and "media_noc_base".
- interrupt: the ldi vblank interrupt number used.
- clocks: the clocks needed. Three clocks are used in ADE driver:
  ADE core clock, value should be "<&media_ctrl HI6220_ADE_CORE>";
  ADE pixel clok, value should be "<&media_ctrl HI6220_ADE_PIX_SRC>";
  media NOC QoS clock, value should be "<&media_ctrl HI6220_CODEC_JPEG>".
- clock-names: the name of the clocks. Values should be "clk_ade_core",
  "clk_codec_jpeg" and "clk_ade_pix".
- assigned-clocks: clocks to be assigned rate.
- assigned-clock-rates: clock rates which are assigned to assigned-clocks.
  The rate of <&media_ctrl HI6220_ADE_CORE> could be "360000000" or
  "180000000";
  The rate of <&media_ctrl HI6220_CODEC_JPEG> could be less than "1440000000".
- port: the output port. This contains one endpoint subnode, with its
  remote-endpoint set to the phandle of the connected DSI input endpoint.
  See Documentation/devicetree/bindings/graph.txt for more device graph info.

Optional properties:
- dma-coherent: Present if dma operations are coherent.


A example of HiKey board hi6220 SoC specific DT entry:
Example:

	ade: ade@f4100000 {
		compatible = "hisilicon,hi6220-ade";
		reg = <0x0 0xf4100000 0x0 0x7800>,
		      <0x0 0xf4410000 0x0 0x1000>,
		      <0x0 0xf4520000 0x0 0x1000>;
		reg-names = "ade_base",
			    "media_base",
			    "media_noc_base";

		interrupts = <0 115 4>; /* ldi interrupt */

		clocks = <&media_ctrl HI6220_ADE_CORE>,
			 <&media_ctrl HI6220_CODEC_JPEG>,
			 <&media_ctrl HI6220_ADE_PIX_SRC>;
		/*clock name*/
		clock-names  = "clk_ade_core",
			       "clk_codec_jpeg",
			       "clk_ade_pix";

		assigned-clocks = <&media_ctrl HI6220_ADE_CORE>,
			<&media_ctrl HI6220_CODEC_JPEG>;
		assigned-clock-rates = <360000000>, <288000000>;
		dma-coherent;

		port {
			ade_out: endpoint {
				remote-endpoint = <&dsi_in>;
			};
		};
	};
```
